/* USER CODE BEGIN Header */
/**
  ******************************************************************************
  * @file           : main.c
  * @brief          : Main program body
  ******************************************************************************
  * @attention
  *
  * Copyright (c) 2025 STMicroelectronics.
  * All rights reserved.
  *
  * This software is licensed under terms that can be found in the LICENSE file
  * in the root directory of this software component.
  * If no LICENSE file comes with this software, it is provided AS-IS.
  *
  ******************************************************************************
  */
/* USER CODE END Header */
/* Includes ------------------------------------------------------------------*/
#include "main.h"
#include "cmsis_os.h"
#include "fatfs.h"

/* Private includes ----------------------------------------------------------*/
/* USER CODE BEGIN Includes */
#include <string.h>
#include <stdio.h>
#include <stdbool.h>
#include "edge_impulse.h"
#include "microphone.h"
#include "print_service.h"
#include "filesystem_shell_commands.h"
#include "FreeRTOS_CLI.h"
/* USER CODE END Includes */

/* Private typedef -----------------------------------------------------------*/
/* USER CODE BEGIN PTD */

/* USER CODE END PTD */

/* Private define ------------------------------------------------------------*/
/* USER CODE BEGIN PD */

/* USER CODE END PD */

/* Private macro -------------------------------------------------------------*/
/* USER CODE BEGIN PM */
TimerHandle_t button_tm, led_tm;
QueueHandle_t 	  queue_button;
SemaphoreHandle_t sem_new_data;

float features[FEATURES_SIZE] = {0.0f};
volatile bool start_mic_task = false;
/* USER CODE END PM */

/* Private variables ---------------------------------------------------------*/

CRC_HandleTypeDef hcrc;

I2S_HandleTypeDef hi2s2;
I2S_HandleTypeDef hi2s3;
DMA_HandleTypeDef hdma_spi2_rx;
DMA_HandleTypeDef hdma_spi3_rx;

RNG_HandleTypeDef hrng;

SD_HandleTypeDef hsd2;
DMA_HandleTypeDef hdma_sdmmc2_rx;
DMA_HandleTypeDef hdma_sdmmc2_tx;

UART_HandleTypeDef huart1;

osThreadId MicAcquisitionHandle;
/* USER CODE BEGIN PV */

/* USER CODE END PV */

/* Private function prototypes -----------------------------------------------*/
void SystemClock_Config(void);
void PeriphCommonClock_Config(void);
static void MX_GPIO_Init(void);
static void MX_DMA_Init(void);
static void MX_I2S2_Init(void);
static void MX_USART1_UART_Init(void);
static void MX_CRC_Init(void);
static void MX_RNG_Init(void);
static void MX_SDMMC2_SD_Init(void);
static void MX_I2S3_Init(void);
void mic_task(void const * argument);

/* USER CODE BEGIN PFP */

/* USER CODE END PFP */

/* Private user code ---------------------------------------------------------*/
/* USER CODE BEGIN 0 */
//--------------------------------------------------------------------+
// BLINKING TASK
//--------------------------------------------------------------------+
void led_blinky_cb(TimerHandle_t xTimer)
{
  (void) xTimer;
  HAL_GPIO_TogglePin(USER_LED2_GPIO_Port, USER_LED2_Pin);
}

BaseType_t read_button(uint8_t *button, TickType_t timeout){
	return xQueueReceive(queue_button, button, timeout);
}

void button_cb(TimerHandle_t xTimer)
{
	(void) xTimer;
	if (HAL_GPIO_ReadPin(BUTTON_GPIO_Port, BUTTON_Pin) == GPIO_PIN_RESET) {
		// guardar em uma fila de botões
		uint8_t button = BUTTON_Pin;
		xQueueSend(queue_button, &button, 0);
	}
	__HAL_GPIO_EXTI_CLEAR_IT(BUTTON_Pin);
	HAL_NVIC_EnableIRQ(EXTI0_IRQn);
}

void HAL_GPIO_EXTI_Callback(uint16_t GPIO_Pin)
{
  if (GPIO_Pin == GPIO_PIN_0)
  {
    HAL_NVIC_DisableIRQ(EXTI0_IRQn);
	portBASE_TYPE pxHigherPriorityTaskWoken = pdFALSE;
    xTimerStartFromISR(button_tm, &pxHigherPriorityTaskWoken);
	portYIELD_FROM_ISR(pxHigherPriorityTaskWoken);
  }
}

//////////////////////////////////////////////////////////
//// Console
///////////////////////////////////////////////////////////
static BaseType_t prvTaskStatsCommand( char *pcWriteBuffer,
                                          size_t xWriteBufferLen,
										  const char *pcCommandString )
{
    static BaseType_t state = 0;

    if (!state){
        /* For simplicity, this function assumes the output buffer is large enough
        to hold all the text generated by executing the vTaskList() API function,
        so the xWriteBufferLen parameter is not used. */
        char *head = "Name		State  Priority  Stack  Number\n\r";
        ( void ) xWriteBufferLen;

        /* pcWriteBuffer is used directly as the vTaskList() parameter, so the table
        generated by executing vTaskList() is written directly into the output
        buffer. */
        strcpy(pcWriteBuffer, head);
        vTaskList( &pcWriteBuffer[strlen(head)]);

        /* The entire table was written directly to the output buffer.  Execution
        of this command is complete, so return pdFALSE. */
        state = 1;
        return pdTRUE;
    }else{
        state = 0;
        strcpy(pcWriteBuffer, "\n\r");
        return pdFALSE;
    }
}

static BaseType_t prvIACommand( char *pcWriteBuffer,
                                  size_t xWriteBufferLen,
                                  const char *pcCommandString )
{
	const char *pcParameter1 = NULL;
	BaseType_t xParameter1StringLength;

    /* Obtain the name of the source file, and the length of its name, from
       the command string. The name of the source file is the first parameter. */
	pcParameter1 = FreeRTOS_CLIGetParameter( pcCommandString,
                                         1,
                                         &xParameter1StringLength );
	if (!strcmp(pcParameter1, "on")){
		start_mic_task = true;
		vTaskResume(MicAcquisitionHandle);
		sprintf(pcWriteBuffer, "IA Task started!\r\n");
	}else{
		if (!strcmp(pcParameter1, "off")){
			sprintf(pcWriteBuffer, "IA Task stopped!\r\n");
			start_mic_task = false;
		}else{
			if (pcParameter1 != NULL){
				uint32_t  p1, s2, cnt, size;
				bool first_block = true;
				char buffer[512];
				int16_t *pbuffer;

				if (f_open(&SDFile, pcParameter1, FA_READ) == FR_OK){
					p1 = f_size(&SDFile);

					uint32_t j = 0;
					while (p1)
					{
						if (p1 >= sizeof(buffer))
						{
							cnt = sizeof(buffer);
							p1 -= sizeof(buffer);
						}
						else
						{
							cnt = (uint16_t)p1;
							p1 = 0;
						}
						if (f_read(&SDFile, buffer, cnt, (unsigned int *)&s2) != FR_OK)
						{
							break;
						}else
						{
							if (first_block){
								pbuffer = (int16_t *)&buffer[sizeof(wav_header_t)];
								size = (s2 - sizeof(wav_header_t));
								first_block = false;
							}else{
								pbuffer = (int16_t *)buffer;
								size = s2;
							}
							for (int i=0; i<size; i += 2){
								//features[j++] = (float)(pbuffer[i] + (pbuffer[i+1] << 8));
								features[j++] = (float)(*pbuffer++);
							}
							if (cnt != s2) break;
						}
					}

					f_close(&SDFile);
					xSemaphoreGive(sem_new_data);
					sprintf(pcWriteBuffer, "Initializating %s audio classification!\r\n", pcParameter1);
				}else{
					sprintf(pcWriteBuffer, "%s does not exist!\r\n", pcParameter1);
				}
			}else{
				sprintf(pcWriteBuffer, "You need to specify a filename!\r\n");
			}
		}
	}

    /* There is only a single line of output produced in all cases. pdFALSE is
       returned because there is no more output to be generated. */
    return pdFALSE;
}

static BaseType_t prvAudioRecordCommand( char *pcWriteBuffer,
                                  size_t xWriteBufferLen,
                                  const char *pcCommandString )
{
	const char *filename;
	static int state = 0;
	BaseType_t xParameter1StringLength;

    /* Obtain the name of the source file, and the length of its name, from
       the command string. The name of the source file is the first parameter. */
	filename = FreeRTOS_CLIGetParameter( pcCommandString,
                                         1,
                                         &xParameter1StringLength );
	switch (state){
		case 0:
			if (filename != NULL){
				if (start_mic_task == false){
					(void)sprintf(pcWriteBuffer, "Recording...\r\n");
					state = 1;
					return pdTRUE;
				}else{
					(void)sprintf(pcWriteBuffer, "Microphone is already being used!\r\n");
				}
			}else {
				(void)sprintf(pcWriteBuffer, "You need to specify a filename!\r\n");
			}
			break;
		case 1:
			record_wav((char *)filename, 1);
			(void)sprintf(pcWriteBuffer, "%s recorded!\r\n", filename);
			state = 0;
			break;
	}

	return pdFALSE;
}

static const CLI_Command_Definition_t xIACommand =
{
    "ia",
	"ia: Enable or disable IA Task (parameter: on and off)\r\n",
	prvIACommand,
    1
};

static const CLI_Command_Definition_t xAudioRecordCommand =
{
    "record",
	"record: Record 1 second of audio (parameter: file name)\r\n",
	prvAudioRecordCommand,
    1
};

static const CLI_Command_Definition_t xTasksCommand =
{
    "tasks",
	"tasks: Lists all the installed tasks\r\n",
	prvTaskStatsCommand,
    0
};

void print_string(char *string, TickType_t timeout) {
	print_service_send(string, 0, timeout);
}

void print_char(char character, TickType_t timeout) {
	print_service_send(&character, 1, timeout);
}

#define cmdPARAMTER_NOT_USED	((void *)0)
#define MAX_INPUT_LENGTH    	64
#define MAX_OUTPUT_LENGTH   	3072

static char pcOutputString[MAX_OUTPUT_LENGTH];
static void shell_task(void *param){
	char cRxedChar;
	BaseType_t cInputIndex = 0;
	BaseType_t xMoreDataToFollow;
	/* The input and output buffers are declared static to keep them off the stack. */
	static char pcInputString[MAX_INPUT_LENGTH];

	FreeRTOS_CLIRegisterCommand(&xTasksCommand);
	FreeRTOS_CLIRegisterCommand(&xIACommand);
	FreeRTOS_CLIRegisterCommand(&xAudioRecordCommand);
	install_fs_shell_commands();

    // Clear screen
	print_string("\033[2J\033[H", portMAX_DELAY);
	// Welcome message
	print_string("Welcome to FreeRTOS ", portMAX_DELAY);
	print_string(tskKERNEL_VERSION_NUMBER, portMAX_DELAY);
	print_string("\n\r", portMAX_DELAY);
	print_string(">>", portMAX_DELAY);

	while(1){
			/* This implementation reads a single character at a time.  Wait in the
	        Blocked state until a character is received. */
			(void)uart_get_char(&cRxedChar, portMAX_DELAY);

	        if( cRxedChar == '\r' )
	        {
	            /* A newline character was received, so the input command string is
	            complete and can be processed.  Transmit a line separator, just to
	            make the output easier to read. */
	        	print_string("\n\r", portMAX_DELAY);

	            /* The command interpreter is called repeatedly until it returns
	            pdFALSE.  See the "Implementing a command" documentation for an
	            exaplanation of why this is. */
	            do
	            {
	                /* Send the command string to the command interpreter.  Any
	                output generated by the command interpreter will be placed in the
	                pcOutputString buffer. */
	                xMoreDataToFollow = FreeRTOS_CLIProcessCommand
	                              (
	                                  pcInputString,   /* The command string.*/
	                                  pcOutputString,  /* The output buffer. */
	                                  MAX_OUTPUT_LENGTH/* The size of the output buffer. */
	                              );

	                /* Write the output generated by the command interpreter to the
	                console. */
	                print_string(pcOutputString, portMAX_DELAY);
	                memset(pcOutputString, 0, MAX_OUTPUT_LENGTH);

	            } while( xMoreDataToFollow != pdFALSE );
                print_string(">>", portMAX_DELAY);

	            /* All the strings generated by the input command have been sent.
	            Processing of the command is complete.  Clear the input string ready
	            to receive the next command. */
	            cInputIndex = 0;
	            memset( pcInputString, 0x00, MAX_INPUT_LENGTH );
	        }
	        else
	        {
	            /* The if() clause performs the processing after a newline character
	            is received.  This else clause performs the processing if any other
	            character is received. */

	            if( cRxedChar == '\n' )
	            {
	                /* Ignore carriage returns. */
	            }
	            //else if( cRxedChar == '\b' )
	            else if( cRxedChar == 0x7F )
	            {
	                /* Backspace was pressed.  Erase the last character in the input
	                buffer - if there are any. */
	                if( cInputIndex > 0 )
	                {
	                    cInputIndex--;
	                    pcInputString[ cInputIndex ] = (char)'\0';
		                print_char(cRxedChar, portMAX_DELAY);
	                }
	            }
	            else
	            {
	                /* A character was entered.  It was not a new line, backspace
	                or carriage return, so it is accepted as part of the input and
	                placed into the input buffer.  When a \n is entered the complete
	                string will be passed to the command interpreter. */
	                if( cInputIndex < MAX_INPUT_LENGTH )
	                {
	                    pcInputString[ cInputIndex ] = cRxedChar;
	                    cInputIndex++;
	                }
	                print_char(cRxedChar, portMAX_DELAY);
	            }
	        }
	}
}
/* USER CODE END 0 */

/**
  * @brief  The application entry point.
  * @retval int
  */
int main(void)
{

  /* USER CODE BEGIN 1 */

  /* USER CODE END 1 */

  /* Enable the CPU Cache */

  /* Enable I-Cache---------------------------------------------------------*/
  SCB_EnableICache();

  /* Enable D-Cache---------------------------------------------------------*/
  SCB_EnableDCache();

  /* MCU Configuration--------------------------------------------------------*/

  /* Reset of all peripherals, Initializes the Flash interface and the Systick. */
  HAL_Init();

  /* USER CODE BEGIN Init */

  /* USER CODE END Init */

  /* Configure the system clock */
  SystemClock_Config();

  /* Configure the peripherals common clocks */
  PeriphCommonClock_Config();

  /* USER CODE BEGIN SysInit */

  /* USER CODE END SysInit */

  /* Initialize all configured peripherals */
  MX_GPIO_Init();
  MX_DMA_Init();
  MX_I2S2_Init();
  MX_USART1_UART_Init();
  MX_CRC_Init();
  MX_RNG_Init();
  MX_SDMMC2_SD_Init();
  MX_FATFS_Init();
  MX_I2S3_Init();
  /* USER CODE BEGIN 2 */

  /* USER CODE END 2 */

  /* USER CODE BEGIN RTOS_MUTEX */
  /* add mutexes, ... */
  /* USER CODE END RTOS_MUTEX */

  /* USER CODE BEGIN RTOS_SEMAPHORES */
  /* add semaphores, ... */
	if (sem_new_data == NULL) {
		sem_new_data = xSemaphoreCreateBinary();
	}
  /* USER CODE END RTOS_SEMAPHORES */

  /* USER CODE BEGIN RTOS_TIMERS */
  /* start timers, add new ones, ... */
	button_tm = xTimerCreate("Button timer", pdMS_TO_TICKS(100), pdFALSE, NULL, button_cb);
	led_tm = xTimerCreate("LED timer", pdMS_TO_TICKS(200), pdTRUE, NULL, led_blinky_cb);
	xTimerStart(led_tm, 0);
  /* USER CODE END RTOS_TIMERS */

  /* USER CODE BEGIN RTOS_QUEUES */
  /* add queues, ... */
	queue_button = xQueueCreate(32, sizeof(uint8_t));
  /* USER CODE END RTOS_QUEUES */

  /* Create the thread(s) */
  /* definition and creation of MicAcquisition */
  osThreadDef(MicAcquisition, mic_task, osPriorityNormal, 0, 1024);
  MicAcquisitionHandle = osThreadCreate(osThread(MicAcquisition), NULL);

  /* USER CODE BEGIN RTOS_THREADS */
  /* add threads, ... */
  print_service_init(2);
  xTaskCreate(Task_edge_impulse, "AI Edge Impulse", 4*1024, NULL, 1, NULL);
  xTaskCreate(shell_task, "Shell", 1024, NULL, 2, NULL);
  /* USER CODE END RTOS_THREADS */

  /* Start scheduler */
  osKernelStart();

  /* We should never get here as control is now taken by the scheduler */

  /* Infinite loop */
  /* USER CODE BEGIN WHILE */
  while (1)
  {
    /* USER CODE END WHILE */

    /* USER CODE BEGIN 3 */
  }
  /* USER CODE END 3 */
}

/**
  * @brief System Clock Configuration
  * @retval None
  */
void SystemClock_Config(void)
{
  RCC_OscInitTypeDef RCC_OscInitStruct = {0};
  RCC_ClkInitTypeDef RCC_ClkInitStruct = {0};

  /** Configure the main internal regulator output voltage
  */
  __HAL_RCC_PWR_CLK_ENABLE();
  __HAL_PWR_VOLTAGESCALING_CONFIG(PWR_REGULATOR_VOLTAGE_SCALE1);

  /** Initializes the RCC Oscillators according to the specified parameters
  * in the RCC_OscInitTypeDef structure.
  */
  RCC_OscInitStruct.OscillatorType = RCC_OSCILLATORTYPE_HSE;
  RCC_OscInitStruct.HSEState = RCC_HSE_ON;
  RCC_OscInitStruct.PLL.PLLState = RCC_PLL_ON;
  RCC_OscInitStruct.PLL.PLLSource = RCC_PLLSOURCE_HSE;
  RCC_OscInitStruct.PLL.PLLM = 25;
  RCC_OscInitStruct.PLL.PLLN = 360;
  RCC_OscInitStruct.PLL.PLLP = RCC_PLLP_DIV2;
  RCC_OscInitStruct.PLL.PLLQ = 7;
  RCC_OscInitStruct.PLL.PLLR = 2;
  if (HAL_RCC_OscConfig(&RCC_OscInitStruct) != HAL_OK)
  {
    Error_Handler();
  }

  /** Initializes the CPU, AHB and APB buses clocks
  */
  RCC_ClkInitStruct.ClockType = RCC_CLOCKTYPE_HCLK|RCC_CLOCKTYPE_SYSCLK
                              |RCC_CLOCKTYPE_PCLK1|RCC_CLOCKTYPE_PCLK2;
  RCC_ClkInitStruct.SYSCLKSource = RCC_SYSCLKSOURCE_PLLCLK;
  RCC_ClkInitStruct.AHBCLKDivider = RCC_SYSCLK_DIV1;
  RCC_ClkInitStruct.APB1CLKDivider = RCC_HCLK_DIV4;
  RCC_ClkInitStruct.APB2CLKDivider = RCC_HCLK_DIV2;

  if (HAL_RCC_ClockConfig(&RCC_ClkInitStruct, FLASH_LATENCY_5) != HAL_OK)
  {
    Error_Handler();
  }
}

/**
  * @brief Peripherals Common Clock Configuration
  * @retval None
  */
void PeriphCommonClock_Config(void)
{
  RCC_PeriphCLKInitTypeDef PeriphClkInitStruct = {0};

  /** Initializes the peripherals clock
  */
  PeriphClkInitStruct.PeriphClockSelection = RCC_PERIPHCLK_SDMMC2|RCC_PERIPHCLK_I2S
                              |RCC_PERIPHCLK_CLK48;
  PeriphClkInitStruct.PLLI2S.PLLI2SN = 192;
  PeriphClkInitStruct.PLLI2S.PLLI2SP = RCC_PLLP_DIV2;
  PeriphClkInitStruct.PLLI2S.PLLI2SR = 2;
  PeriphClkInitStruct.PLLI2S.PLLI2SQ = 2;
  PeriphClkInitStruct.PLLSAI.PLLSAIN = 192;
  PeriphClkInitStruct.PLLSAI.PLLSAIR = 2;
  PeriphClkInitStruct.PLLSAI.PLLSAIQ = 2;
  PeriphClkInitStruct.PLLSAI.PLLSAIP = RCC_PLLSAIP_DIV4;
  PeriphClkInitStruct.PLLI2SDivQ = 1;
  PeriphClkInitStruct.PLLSAIDivQ = 1;
  PeriphClkInitStruct.PLLSAIDivR = RCC_PLLSAIDIVR_2;
  PeriphClkInitStruct.I2sClockSelection = RCC_I2SCLKSOURCE_PLLI2S;
  PeriphClkInitStruct.Clk48ClockSelection = RCC_CLK48SOURCE_PLLSAIP;
  PeriphClkInitStruct.Sdmmc2ClockSelection = RCC_SDMMC2CLKSOURCE_CLK48;
  if (HAL_RCCEx_PeriphCLKConfig(&PeriphClkInitStruct) != HAL_OK)
  {
    Error_Handler();
  }
}

/**
  * @brief CRC Initialization Function
  * @param None
  * @retval None
  */
static void MX_CRC_Init(void)
{

  /* USER CODE BEGIN CRC_Init 0 */

  /* USER CODE END CRC_Init 0 */

  /* USER CODE BEGIN CRC_Init 1 */

  /* USER CODE END CRC_Init 1 */
  hcrc.Instance = CRC;
  hcrc.Init.DefaultPolynomialUse = DEFAULT_POLYNOMIAL_ENABLE;
  hcrc.Init.DefaultInitValueUse = DEFAULT_INIT_VALUE_ENABLE;
  hcrc.Init.InputDataInversionMode = CRC_INPUTDATA_INVERSION_NONE;
  hcrc.Init.OutputDataInversionMode = CRC_OUTPUTDATA_INVERSION_DISABLE;
  hcrc.InputDataFormat = CRC_INPUTDATA_FORMAT_BYTES;
  if (HAL_CRC_Init(&hcrc) != HAL_OK)
  {
    Error_Handler();
  }
  /* USER CODE BEGIN CRC_Init 2 */

  /* USER CODE END CRC_Init 2 */

}

/**
  * @brief I2S2 Initialization Function
  * @param None
  * @retval None
  */
static void MX_I2S2_Init(void)
{

  /* USER CODE BEGIN I2S2_Init 0 */

  /* USER CODE END I2S2_Init 0 */

  /* USER CODE BEGIN I2S2_Init 1 */

  /* USER CODE END I2S2_Init 1 */
  hi2s2.Instance = SPI2;
  hi2s2.Init.Mode = I2S_MODE_MASTER_RX;
  hi2s2.Init.Standard = I2S_STANDARD_PHILIPS;
  hi2s2.Init.DataFormat = I2S_DATAFORMAT_24B;
  hi2s2.Init.MCLKOutput = I2S_MCLKOUTPUT_DISABLE;
  hi2s2.Init.AudioFreq = I2S_AUDIOFREQ_48K;
  hi2s2.Init.CPOL = I2S_CPOL_HIGH;
  hi2s2.Init.ClockSource = I2S_CLOCK_PLL;
  if (HAL_I2S_Init(&hi2s2) != HAL_OK)
  {
    Error_Handler();
  }
  /* USER CODE BEGIN I2S2_Init 2 */

  /* USER CODE END I2S2_Init 2 */

}

/**
  * @brief I2S3 Initialization Function
  * @param None
  * @retval None
  */
static void MX_I2S3_Init(void)
{

  /* USER CODE BEGIN I2S3_Init 0 */

  /* USER CODE END I2S3_Init 0 */

  /* USER CODE BEGIN I2S3_Init 1 */

  /* USER CODE END I2S3_Init 1 */
  hi2s3.Instance = SPI3;
  hi2s3.Init.Mode = I2S_MODE_MASTER_RX;
  hi2s3.Init.Standard = I2S_STANDARD_PHILIPS;
  hi2s3.Init.DataFormat = I2S_DATAFORMAT_24B;
  hi2s3.Init.MCLKOutput = I2S_MCLKOUTPUT_DISABLE;
  hi2s3.Init.AudioFreq = I2S_AUDIOFREQ_48K;
  hi2s3.Init.CPOL = I2S_CPOL_HIGH;
  hi2s3.Init.ClockSource = I2S_CLOCK_PLL;
  if (HAL_I2S_Init(&hi2s3) != HAL_OK)
  {
    Error_Handler();
  }
  /* USER CODE BEGIN I2S3_Init 2 */

  /* USER CODE END I2S3_Init 2 */

}

/**
  * @brief RNG Initialization Function
  * @param None
  * @retval None
  */
static void MX_RNG_Init(void)
{

  /* USER CODE BEGIN RNG_Init 0 */

  /* USER CODE END RNG_Init 0 */

  /* USER CODE BEGIN RNG_Init 1 */

  /* USER CODE END RNG_Init 1 */
  hrng.Instance = RNG;
  if (HAL_RNG_Init(&hrng) != HAL_OK)
  {
    Error_Handler();
  }
  /* USER CODE BEGIN RNG_Init 2 */

  /* USER CODE END RNG_Init 2 */

}

/**
  * @brief SDMMC2 Initialization Function
  * @param None
  * @retval None
  */
static void MX_SDMMC2_SD_Init(void)
{

  /* USER CODE BEGIN SDMMC2_Init 0 */

  /* USER CODE END SDMMC2_Init 0 */

  /* USER CODE BEGIN SDMMC2_Init 1 */

  /* USER CODE END SDMMC2_Init 1 */
  hsd2.Instance = SDMMC2;
  hsd2.Init.ClockEdge = SDMMC_CLOCK_EDGE_RISING;
  hsd2.Init.ClockBypass = SDMMC_CLOCK_BYPASS_DISABLE;
  hsd2.Init.ClockPowerSave = SDMMC_CLOCK_POWER_SAVE_DISABLE;
  hsd2.Init.BusWide = SDMMC_BUS_WIDE_1B;
  hsd2.Init.HardwareFlowControl = SDMMC_HARDWARE_FLOW_CONTROL_DISABLE;
  hsd2.Init.ClockDiv = 0;
  /* USER CODE BEGIN SDMMC2_Init 2 */

  /* USER CODE END SDMMC2_Init 2 */

}

/**
  * @brief USART1 Initialization Function
  * @param None
  * @retval None
  */
static void MX_USART1_UART_Init(void)
{

  /* USER CODE BEGIN USART1_Init 0 */

  /* USER CODE END USART1_Init 0 */

  /* USER CODE BEGIN USART1_Init 1 */

  /* USER CODE END USART1_Init 1 */
  huart1.Instance = USART1;
  huart1.Init.BaudRate = 115200;
  huart1.Init.WordLength = UART_WORDLENGTH_8B;
  huart1.Init.StopBits = UART_STOPBITS_1;
  huart1.Init.Parity = UART_PARITY_NONE;
  huart1.Init.Mode = UART_MODE_TX_RX;
  huart1.Init.HwFlowCtl = UART_HWCONTROL_NONE;
  huart1.Init.OverSampling = UART_OVERSAMPLING_16;
  huart1.Init.OneBitSampling = UART_ONE_BIT_SAMPLE_DISABLE;
  huart1.AdvancedInit.AdvFeatureInit = UART_ADVFEATURE_NO_INIT;
  if (HAL_UART_Init(&huart1) != HAL_OK)
  {
    Error_Handler();
  }
  /* USER CODE BEGIN USART1_Init 2 */

  /* USER CODE END USART1_Init 2 */

}

/**
  * Enable DMA controller clock
  */
static void MX_DMA_Init(void)
{

  /* DMA controller clock enable */
  __HAL_RCC_DMA1_CLK_ENABLE();
  __HAL_RCC_DMA2_CLK_ENABLE();

  /* DMA interrupt init */
  /* DMA1_Stream0_IRQn interrupt configuration */
  HAL_NVIC_SetPriority(DMA1_Stream0_IRQn, 5, 0);
  HAL_NVIC_EnableIRQ(DMA1_Stream0_IRQn);
  /* DMA1_Stream1_IRQn interrupt configuration */
  HAL_NVIC_SetPriority(DMA1_Stream1_IRQn, 5, 0);
  HAL_NVIC_EnableIRQ(DMA1_Stream1_IRQn);
  /* DMA2_Stream0_IRQn interrupt configuration */
  HAL_NVIC_SetPriority(DMA2_Stream0_IRQn, 5, 0);
  HAL_NVIC_EnableIRQ(DMA2_Stream0_IRQn);
  /* DMA2_Stream5_IRQn interrupt configuration */
  HAL_NVIC_SetPriority(DMA2_Stream5_IRQn, 5, 0);
  HAL_NVIC_EnableIRQ(DMA2_Stream5_IRQn);

}

/**
  * @brief GPIO Initialization Function
  * @param None
  * @retval None
  */
static void MX_GPIO_Init(void)
{
  GPIO_InitTypeDef GPIO_InitStruct = {0};
  /* USER CODE BEGIN MX_GPIO_Init_1 */

  /* USER CODE END MX_GPIO_Init_1 */

  /* GPIO Ports Clock Enable */
  __HAL_RCC_GPIOB_CLK_ENABLE();
  __HAL_RCC_GPIOD_CLK_ENABLE();
  __HAL_RCC_GPIOA_CLK_ENABLE();
  __HAL_RCC_GPIOJ_CLK_ENABLE();
  __HAL_RCC_GPIOC_CLK_ENABLE();
  __HAL_RCC_GPIOG_CLK_ENABLE();
  __HAL_RCC_GPIOH_CLK_ENABLE();
  __HAL_RCC_GPIOI_CLK_ENABLE();

  /*Configure GPIO pin Output Level */
  HAL_GPIO_WritePin(GPIOJ, USER_LED1_Pin|USER_LED2_Pin, GPIO_PIN_RESET);

  /*Configure GPIO pins : USER_LED1_Pin USER_LED2_Pin */
  GPIO_InitStruct.Pin = USER_LED1_Pin|USER_LED2_Pin;
  GPIO_InitStruct.Mode = GPIO_MODE_OUTPUT_PP;
  GPIO_InitStruct.Pull = GPIO_NOPULL;
  GPIO_InitStruct.Speed = GPIO_SPEED_FREQ_LOW;
  HAL_GPIO_Init(GPIOJ, &GPIO_InitStruct);

  /*Configure GPIO pin : PI15 */
  GPIO_InitStruct.Pin = GPIO_PIN_15;
  GPIO_InitStruct.Mode = GPIO_MODE_INPUT;
  GPIO_InitStruct.Pull = GPIO_NOPULL;
  HAL_GPIO_Init(GPIOI, &GPIO_InitStruct);

  /*Configure GPIO pin : BUTTON_Pin */
  GPIO_InitStruct.Pin = BUTTON_Pin;
  GPIO_InitStruct.Mode = GPIO_MODE_IT_FALLING;
  GPIO_InitStruct.Pull = GPIO_PULLUP;
  HAL_GPIO_Init(BUTTON_GPIO_Port, &GPIO_InitStruct);

  /* EXTI interrupt init*/
  HAL_NVIC_SetPriority(EXTI0_IRQn, 5, 0);
  HAL_NVIC_EnableIRQ(EXTI0_IRQn);

  /* USER CODE BEGIN MX_GPIO_Init_2 */

  /* USER CODE END MX_GPIO_Init_2 */
}

/* USER CODE BEGIN 4 */

/* USER CODE END 4 */

/* USER CODE BEGIN Header_mic_task */
/**
  * @brief  Function implementing the MicAcquisition thread.
  * @param  argument: Not used
  * @retval None
  */
/* USER CODE END Header_mic_task */
void mic_task(void const * argument)
{
  /* USER CODE BEGIN 5 */
#if 0
	  uint32_t file_number = 0;
	  char filename[64];
	  uint8_t button;

	  mic_init();

	  if (f_mount(&SDFatFS, SDPath, 1) != FR_OK){
		  vTaskSuspend(NULL);
	  }

	  /* Infinite loop */
	  for(;;)
	  {
		//vTaskDelay(5000);
		read_button(&button, portMAX_DELAY);
		HAL_GPIO_WritePin(USER_LED1_GPIO_Port, USER_LED1_Pin, GPIO_PIN_SET);
		sprintf(filename, "audio_%ld.wav", file_number);
		record_wav(filename, 1);
		HAL_GPIO_WritePin(USER_LED1_GPIO_Port, USER_LED1_Pin, GPIO_PIN_RESET);
		file_number++;
	  }
#endif
#if 1
	  uint32_t bytes_read = 0;
	  uint32_t flag = 0;
	  mic_init();

	  vTaskSuspend(NULL);

	  /* Infinite loop */
	  for(;;)
	  {
		// Start microphone capture
	    while(1){
			if (flag == 0){
				flag = 1;
				mic_start();
				uint32_t noise_time = MIC_BYTE_RATE / 5;	// 200 ms
				uint32_t audio_size = 0;
				while (audio_size < noise_time) {
					// Read the RAW samples from the microphone
					bytes_read = mic_read();
					audio_size += bytes_read;
				}
				print_service_send("Speak!\n", 0, 10);
			}
			bytes_read = mic_read_in_float();
			if (!raw_feature_set_data(get_read_float_buffer(), bytes_read)){
				mic_stop();
				xSemaphoreGive(sem_new_data);
				vTaskDelay(1000);
				flag = 0;
				if (!start_mic_task){
					vTaskSuspend(NULL);
				}
			}
	    }
	  }
#endif
  /* USER CODE END 5 */
}

/**
  * @brief  Period elapsed callback in non blocking mode
  * @note   This function is called  when TIM14 interrupt took place, inside
  * HAL_TIM_IRQHandler(). It makes a direct call to HAL_IncTick() to increment
  * a global variable "uwTick" used as application time base.
  * @param  htim : TIM handle
  * @retval None
  */
void HAL_TIM_PeriodElapsedCallback(TIM_HandleTypeDef *htim)
{
  /* USER CODE BEGIN Callback 0 */

  /* USER CODE END Callback 0 */
  if (htim->Instance == TIM14)
  {
    HAL_IncTick();
  }
  /* USER CODE BEGIN Callback 1 */

  /* USER CODE END Callback 1 */
}

/**
  * @brief  This function is executed in case of error occurrence.
  * @retval None
  */
void Error_Handler(void)
{
  /* USER CODE BEGIN Error_Handler_Debug */
  /* User can add his own implementation to report the HAL error return state */
  __disable_irq();
  while (1)
  {
  }
  /* USER CODE END Error_Handler_Debug */
}

#ifdef  USE_FULL_ASSERT
/**
  * @brief  Reports the name of the source file and the source line number
  *         where the assert_param error has occurred.
  * @param  file: pointer to the source file name
  * @param  line: assert_param error line source number
  * @retval None
  */
void assert_failed(uint8_t *file, uint32_t line)
{
  /* USER CODE BEGIN 6 */
  /* User can add his own implementation to report the file name and line number,
     ex: printf("Wrong parameters value: file %s on line %d\r\n", file, line) */
  /* USER CODE END 6 */
}
#endif /* USE_FULL_ASSERT */
